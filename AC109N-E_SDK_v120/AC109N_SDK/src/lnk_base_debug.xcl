////////////////////////////////////////////////////////////////////////////////
//
// This is a XLINK command file.
//
//
//   Revision control system
//       $Id: lnk_base.xcl 1.99 2006/05/02 09:39:07Z owi ADx_patch $
////////////////////////////////////////////////////////////////////////////////

////////////////////////////////////////////////////////////////////////////////
// OTP data:                0-0xFF                      256Bytes
// ESP:                     0x800-0x8FF                 256Bytes
// OTP xdata:               0x900-0x144F                2.5KBytes
// DECODE BUF:              0x1850-0x1FFF               2048-80 Bytes
// 2线调试时，0x1A40~0x1FFF不能使用。
////////////////////////////////////////////////////////////////////////////////


////////////////////////////////////////////////////////////////////////////////
//
// Variables (used by lnk_base.xcl)
// ================================
//
// Segment limits
// --------------
//
//
//    DATA
//
-D_DATA_START=0x30
-D_DATA_END=0x7F 
//
//    IDATA
//
-D_IDATA_START=0x80
-D_IDATA_END=0xFF              // Last address of Idata memory (0xFF for 8052 and 0x7F for 8051)
//
//
//    PDATA
//
//-D_PDATA_START=0x0001          // First address for PDATA memory.
//-D_PDATA_END=0x00FF            // Last address for PDATA memory.
//
//
//    XDATA
//
-D_XDATA_START=0x000980        // First address of xdata memory.
-D_XDATA_END=0x00144F          // Last address of xdata memory.
//
//
//    CODE
//
//-D_CODE_START=0x00DA40         // First address for code. total 6K
//-D_CODE_END=0x00FA3F           // Last address for code.
//
//
//    BANKED CODE
//
-D_BANKED_CODE_START=0xF240
-D_BANKED_CODE_END=0xF9BF
-D_BANKED1_CODE_END=0xFA3F        // Last address for near code. total 2K
//
//    NEAR CODE
//
-D_NEAR_CODE_START=0x00DA40
-D_NEAR_CODE_END=0x00F23F        // Last address for near code.
//
//
//
//
//
// Special SFRs
// ------------
//
//
//    CODE bank setup
//
//-D_FIRST_BANK_ADDR=0x10000
//-D_NR_OF_BANKS=0x0
//
//
//    Register bank setup
//
-D?REGISTER_BANK=0             // Default register bank (0,1,2,3).
-D_REGISTER_BANK_START=0       // Start address for default register bank (00,08,10,18).
//
//
//    PDATA page setup
//
-D?PBANK_NUMBER=1	       // high byte of 16-bit address to the PDATA area
-D?PBANK=0x94                    // Most significant byte in MOVX A,@R0. (0xA0 is sfr P2)
//-D?PBANK_EXT=0x8B              // Most significant byte in MOVX A,@R0. (0xEA is for Dallas DS80C390)
//
//
//    Virtual register setup
//    ----------------------
//
-D_BREG_START=0x0             // The bit address where the BREG segments starts.
                               // Must be placed on: _BREG_START%8=0 where _BREG_START <= 0x78.
-D?VB=0x20                     // ?VB is used when referencing BREG as whole byte.
                               // Must be placed on: ?VB=0x20+_BREG_START/8                         
-D?ESP=87                     // ESP Extended Stack Pointer
//-D?ACON=9D                     // ACON Address Control Register
//-D?DPS1=F6                     // DPTR Control Register
//-D?DP1L=88
//-D?DP1H=91
//
//
////////////////////////////////////////////////////////////////////////////////

////////////////////////////////////////////////////////////////////////////////
//
// IDATA memory
//

// Setup "bit" segments (only for '__no_init bool' variables).

-Z(BIT)BREG=_BREG_START
-Z(BIT)BIT_N=18-7F
-Z(DATA)REGISTERS+8=_REGISTER_BANK_START
-Z(DATA)VREG+_NR_OF_VIRTUAL_REGISTERS=08-2F
-Z(DATA)PSP,XSP#1F
-Z(DATA)BDATA_Z,BDATA_N,BDATA_I#2F

-Z(DATA)DOVERLAY=_DATA_START-_DATA_END
-Z(DATA)DATA_I,DATA_Z,DATA_N=_DATA_START-_DATA_END
-U(IDATA)0-7F=(DATA)0-7F
-Z(IDATA)IDATA_I,IDATA_Z,IDATA_N=_DATA_START-_IDATA_END
-Z(IDATA)ISTACK+_IDATA_STACK_SIZE#_DATA_START-_IDATA_END
-Z(IDATA)IOVERLAY=_DATA_START-_IDATA_END

////////////////////////////////////////////////////////////////////////////////
//
// ROM memory
//

// Note: INTVEC must be placed first.
// Note: CSTART Must be located in first 64k.

//
// Program memory
//
-Z(CODE)INTVEC=0xE000
-Z(CODE)FUN_ENTRY#0x9EC6

/*----Common Code------*/
-Z(CODE)CODE_C=_NEAR_CODE_START-_NEAR_CODE_END
-Z(CODE)NEAR_CODE=_NEAR_CODE_START-_NEAR_CODE_END
-Z(CODE)RCODE,MY_UART=_NEAR_CODE_START-_NEAR_CODE_END
-Z(CODE)DIFUNCT=_NEAR_CODE_START-_NEAR_CODE_END

/*-------2012/09/13 Bingquan added------------*/
-Z(CODE)COMMON_CODE,TABLE_CODE=_NEAR_CODE_START-_NEAR_CODE_END
/*--Key*/
-Z(CODE)KEY_CODE=_NEAR_CODE_START-_NEAR_CODE_END


//
// Initializers
//
-Z(CODE)BIT_ID,BDATA_ID,DATA_ID,IDATA_ID,IXDATA_ID,PDATA_ID,XDATA_ID=_NEAR_CODE_START-_NEAR_CODE_END

//
// Constants located in code memory
//


//-P(CODE)MAIN,GET_MUSIC_FILE,GET_DEVICE,MUSIC_PLAY,BANKED_CODE=[_BANKED_CODE_START-_BANKED_CODE_END]*4+10000 //  Setup bank-switched segments.

//CSTART必须在bank0(常驻Bank)
/*----Bank0 Code------*/
-P(CODE)CSTART,BANK0_CODE,BANK0_TABLE_CODE=_BANKED_CODE_START-_BANKED_CODE_END
-P(CODE)DAC_CODE,DAC_TABLE_CODE=_BANKED_CODE_START-_BANKED_CODE_END

/*----Bank1 Code------*/
-P(CODE)MUSIC_PLAY,BANK1_CODE,BANK1_TABLE_CODE=(_BANKED_CODE_START+0x10000)-(_BANKED_CODE_END+0x10000)

/*----Bank2 Code------*/
-P(CODE)GET_MUSIC_FILE,GET_DEVICE,FS_CODE,BANK2_CODE,BANK2_TABLE_CODE=(_BANKED_CODE_START+0x20000)-(_BANKED_CODE_END+0x20000)

/*----Bank3 Code------*/
-P(CODE)USB_DEVICE_CODE,USB_HOST_CODE,BANKED_CODE,BANK3_CODE,BANK3_TABLE_CODE=(_BANKED_CODE_START+0x30000)-(_BANKED_CODE_END+0x30000)

/*----Bank4 Code------*/
-P(CODE)RTC_CODE,BANK4_CODE,BANK4_TABLE_CODE=(_BANKED_CODE_START+0x40000)-(_BANKED_CODE_END+0x40000)

/*----Bank5 Code------*/
-P(CODE)LINE_IN_CODE,BANK5_CODE,BANK5_TABLE_CODE=(_BANKED_CODE_START+0x50000)-(_BANKED_CODE_END+0x50000)
-P(CODE)LED_5X7_CODE,LED_5X7_TABLE_CODE=(_BANKED_CODE_START+0x50000)-(_BANKED_CODE_END+0x50000)
-P(CODE)LCD_SEG_CODE,LCD_SEG_TABLE_CODE=(_BANKED_CODE_START+0x50000)-(_BANKED_CODE_END+0x50000)
-P(CODE)LCD_CODE=(_BANKED_CODE_START+0x50000)-(_BANKED_CODE_END+0x50000)
-P(CODE)UI_COMMON_CODE,UI_TABLE_CODE=(_BANKED_CODE_START+0x50000)-(_BANKED_CODE_END+0x50000)


/*----Bank6 Code------*/
-P(CODE)BK1080_CODE,BK1080_TABLE_CODE=(_BANKED_CODE_START+0x60000)-(_BANKED_CODE_END+0x60000)
-P(CODE)KT0830_CODE,KT0830_TABLE_CODE=(_BANKED_CODE_START+0x60000)-(_BANKED_CODE_END+0x60000)
-P(CODE)QN0835_CODE,QN0835_TABLE_CODE=(_BANKED_CODE_START+0x60000)-(_BANKED_CODE_END+0x60000)
-P(CODE)RDA5807_CODE,RDA5807_TABLE_CODE=(_BANKED_CODE_START+0x60000)-(_BANKED_CODE_END+0x60000)
-P(CODE)AR1019_CODE,AR1019_TABLE_CODE,BANK6_CODE,BANK6_TABLE_CODE=(_BANKED_CODE_START+0x60000)-(_BANKED_CODE_END+0x60000)

/*----Bank7 Code------*/
-P(CODE)IIC_CODE,IIC_TABLE_CODE,FM_CODE,FM_TABLE_CODE,BANK7_CODE,BANK7_TABLE_CODE=(_BANKED_CODE_START+0x70000)-(_BANKED_CODE_END+0x70000)
-P(CODE)BIKE_CODE,BIKE_TABLE_CODE=(_BANKED_CODE_START+0x70000)-(_BANKED_CODE_END+0x70000)

-M(CODE)_NEAR_CODE_START-_NEAR_CODE_END=0-17FF
-M(CODE)[_BANKED_CODE_START-_BANKED1_CODE_END]*8+10000=1800

//-Z(CODE)CHECKSUM#_CODE_END

////////////////////////////////////////////////////////////////////////////////
//
// XDATA memory
//

//
// Stacks located in XDATA
//
-Z(XDATA)EXT_STACK+_EXTENDED_STACK_SIZE=_EXTENDED_STACK_START-_EXTENDED_STACK_END
//-Z(XDATA)PSTACK+_PDATA_STACK_SIZE=_PDATA_START-_PDATA_END
//-Z(XDATA)XSTACK+_XDATA_STACK_SIZE=_XDATA_START-_XDATA_END

//
// PDATA - data memory
//
//-Z(XDATA)PDATA_N,PDATA_Z,PDATA_I=_PDATA_START-_PDATA_END

//
// XDATA - data memory
//
-Z(XDATA)INTERRUPT_TABLE=0x100
-Z(XDATA)DECODE_MSG_V=0x180
-Z(XDATA)FATFS_V=0x14F
-Z(XDATA)FF_API_TEMP=0x200
-Z(XDATA)FAT_API_V=0x980
-Z(XDATA)IXDATA_N,IXDATA_Z,IXDATA_I,USB_HOST_XDATA=_XDATA_START-_XDATA_END
-Z(XDATA)XDATA_N,XDATA_Z,XDATA_I=_XDATA_START-_XDATA_END
-Z(XDATA)XDATA_HEAP+_XDATA_HEAP_SIZE=_XDATA_START-_XDATA_END
-Z(CONST)XDATA_ROM_C=_XDATA_START-_XDATA_END
-Z(XDATA)FAT_PATH_TEMP=0x0218C0
-Z(XDATA)DEC_BUF#0x1FFF
-Z(XDATA)FAT_API_TEMP=0x2000-0x3A00
-Z(XDATA)FAT_API_V0=0x0172

-cx51
-R









